## boards/mantelclock/mantelclock_defconfig
```kconfig
# SPDX-License-Identifier: Apache-2.0

# Enable MPU
CONFIG_ARM_MPU=y

# Enable HW stack protection
CONFIG_HW_STACK_PROTECTION=y

# enable GPIO
CONFIG_GPIO=y

# SPI
CONFIG_SPI=y

# Real-time clock
CONFIG_RTC=y

# PWM
CONFIG_PWM=y

# Enable regulator
CONFIG_REGULATOR=y
CONFIG_REGULATOR_FIXED_INIT_PRIORITY=50

# Timers
CONFIG_CLOCK_CONTROL=y

# LVGL Includes
CONFIG_LVGL=y 
CONFIG_GC9X01X=y
CONFIG_DISPLAY=y
CONFIG_INPUT=y
CONFIG_LV_Z_KEYPAD_INPUT=y

# LVGL Requirements
CONFIG_MAIN_STACK_SIZE=32768
CONFIG_HEAP_MEM_POOL_SIZE=30000
CONFIG_LV_Z_MEM_POOL_SIZE=30000
CONFIG_LV_Z_VDB_SIZE=10
CONFIG_LV_COLOR_DEPTH_16=y
CONFIG_LV_COLOR_16_SWAP=y
```
